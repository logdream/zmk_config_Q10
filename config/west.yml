## config/west.yml
```yaml
manifest:
  remotes:
    - name: zmkfirmware
      url-base: https://github.com/zmkfirmware
    - name: ZitaoTech
      url-base: https://github.com/logdream
  projects:
    - name: zmk
      remote: ZitaoTech
      revision: bbkeyboard_tp
      import: app/west.yml
  self:
    path: config
```
